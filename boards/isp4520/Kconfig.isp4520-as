## boards/isp4520/Kconfig.isp4520-as
```kconfig
# nRF52 DK nRF52810 board configuration

# Copyright (c) 2018 Nordic Semiconductor ASA
# SPDX-License-Identifier: Apache-2.0

config BOARD_ISP4520_AS
	select SOC_NRF52832_QFAA
```

## boards/isp4520/board.yml
```yaml
boards:
 - name: isp4520-eu
   vendor: insightsip
   socs:
   - name: nrf52832
 - name: isp4520-as
   vendor: insightsip
   socs:
   - name: nrf52832
 - name: isp4520-us
   vendor: insightsip
   socs:
   - name: nrf52832
```

## drivers/lora_lbm/Kconfig.sx12xx
```kconfig
# Copyright (c) 2024 Semtech Corporation - Félix Piédallu
# SPDX-License-Identifier: Apache-2.0

# LoRa transceiver drivers configuration options

config SEMTECH_SX126X
	bool "Semtech SX126x family LoRa transceiver driver"
	default y
	depends on DT_HAS_SEMTECH_SX1261_NEW_ENABLED || DT_HAS_SEMTECH_SX1262_NEW_ENABLED || DT_HAS_SEMTECH_SX1268_NEW_ENABLED || DT_HAS_ST_STM32WL_SUBGHZ_RADIO_NEW_ENABLED
	select SPI
	help
	  Enable driver for the SX126x family and stm32wl embedded LoRa transceiver driver

config SEMTECH_SX127X
	bool "Semtech SX127x family LoRa transceiver driver"
	default y
	depends on DT_HAS_SEMTECH_SX1272_NEW_ENABLED || DT_HAS_SEMTECH_SX1276_NEW_ENABLED || DT_HAS_SEMTECH_SX1278_NEW_ENABLED
	select SPI
	help
	  Enable driver for the SX127x family LoRa transceiver driver

config SEMTECH_SX128X
	bool "Semtech SX128x family LoRa transceiver driver"
	default y
	depends on DT_HAS_SEMTECH_SX1280_NEW_ENABLED || DT_HAS_SEMTECH_SX1281_NEW_ENABLED
	select SPI
	help
	  Enable driver for the SX128x family LoRa transceiver driver
```

## modules/Kconfig
```kconfig
# Copyright (c) 2019 Intel Corporation
# SPDX-License-Identifier: Apache-2.0

comment "LoRa Basics Modem module not available."
	depends on !ZEPHYR_LORA_BASICS_MODEM_MODULE

# This ensures that symbols are available in Kconfig for dependency checking
# and referencing, while keeping the settings themselves unavailable when the
# modules are not present in the workspace
if 0
osource "modules/*/Kconfig"
endif
```

## modules/lora_basics_modem/app_helpers/apps_common/Kconfig
```kconfig
# Copyright (c) 2024 Semtech Corporation - Félix Piédallu
# SPDX-License-Identifier: Apache-2.0

menuconfig LORA_BASICS_MODEM_APPS_COMMON
    bool "Enable common wrapper for apps"
    default y

if LORA_BASICS_MODEM_APPS_COMMON

config LORA_BASICS_MODEM_PRINTERS
    bool "Enable printer helpers"
    default y if LOG
    default y if PRINTK
    default n
    help
        Enable this to get acecss to functions that take a lora basics
        modem enum and return a static string, so it may be printed/logged

module = SMTC_APP
module-str = smtc_app
source "subsys/logging/Kconfig.template.log_config"

endif # LORA_BASICS_MODEM_APPS_COMMON
```

## subsys/Kconfig
```kconfig
# Subsystem configuration options

# Copyright (c) 2016-2017 Intel Corporation
# Copyright (c) 2021 Nordic Semiconductor
# SPDX-License-Identifier: Apache-2.0

menu "Subsystems and OS Services"

rsource "lorawan_lbm/Kconfig"

endmenu
```

## west.yml
```yaml
# Copyright (c) 2024 Semtech Corporation
# SPDX-License-Identifier: Apache-2.0

manifest:
  projects:
    - name: zephyr
      url: https://github.com/zephyrproject-rtos/zephyr
      revision: v3.7.0
      import: true

    - name: lora_basics_modem
      path: modules/lib/lora_basics_modem
      url: https://github.com/lora-net/SWL2001
      revision: v4.8.0

  self:
    path: application
```
